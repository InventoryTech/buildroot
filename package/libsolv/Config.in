## package/libsolv/Config.in
```kconfig
config BR2_PACKAGE_LIBSOLV
	bool "libsolv"
	depends on BR2_USE_MMU # fork()
	select BR2_PACKAGE_ZLIB
	help
	  A free package dependency solver using a satisfiability
	  algorithm.

	  https://github.com/openSUSE/libsolv

if BR2_PACKAGE_LIBSOLV

config BR2_PACKAGE_LIBSOLV_DEBIAN
	bool "debian repository support"
	help
	  Build with debian database/repository support.

endif
```
